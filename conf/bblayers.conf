## conf/bblayers.conf
```bitbake
POKY_BBLAYERS_CONF_VERSION = "2"

BBPATH = "${TOPDIR}"
BBFILES ?= ""

BBLAYERS ?= " \
    ${TOPDIR}/../sources/openembedded-core/meta \
    ${TOPDIR}/../sources/meta-yocto/meta-poky \
    ${TOPDIR}/../sources/meta-yocto/meta-yocto-bsp \
    ${TOPDIR}/../sources/meta-raspberrypi \
    ${TOPDIR}/../sources/meta-bruno \
"
```

## conf/local.conf
```bitbake
MACHINE = "raspberrypi3-64"

DISTRO = "poky"

DL_DIR = "/downloads"

SSTATE_DIR = "/sstate-cache"

PACKAGE_CLASSES = "package_rpm"

EXTRA_IMAGE_FEATURES ?= "debug-tweaks"
```
